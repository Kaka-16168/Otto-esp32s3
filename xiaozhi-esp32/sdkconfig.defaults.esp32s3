## xiaozhi-esp32/sdkconfig.defaults.esp32s3
```kconfig
CONFIG_IDF_TARGET="esp32s3"
CONFIG_BOARD_TYPE_OTTO_ROBOT=y
CONFIG_HTTPD_WS_SUPPORT=y

CONFIG_ESPTOOLPY_FLASHSIZE_16MB=y
CONFIG_ESPTOOLPY_FLASHSIZE="16MB"
CONFIG_PARTITION_TABLE_CUSTOM=y
CONFIG_PARTITION_TABLE_CUSTOM_FILENAME="partitions/v2/16m.csv"
CONFIG_PARTITION_TABLE_FILENAME="partitions/v2/16m.csv"

# 强制降频，防止芯片读取失败
CONFIG_ESPTOOLPY_FLASHMODE_DIO=y
CONFIG_ESPTOOLPY_FLASHFREQ_40M=y

# 8MB PSRAM (绝对不可缺失)
CONFIG_SPIRAM=y
CONFIG_SPIRAM_MODE_OCT=y
CONFIG_SPIRAM_SPEED_80M=y
CONFIG_SPIRAM_USE_MALLOC=y

# 资源打包
CONFIG_FLASH_DEFAULT_ASSETS=y
CONFIG_USE_DEFAULT_ASSETS=y
CONFIG_LANGUAGE_ZH_CN=y

# 【核心杀招】强制启用自定义 MultiNet，并关闭一切官方冲突项
CONFIG_USE_CUSTOM_WAKE_WORD=y
CONFIG_CUSTOM_WAKE_WORD="ka ka"
CONFIG_CUSTOM_WAKE_WORD_DISPLAY="卡卡"
CONFIG_SR_MN_CN_MULTINET7_QUANT=y

# 显式禁用官方 Hi ESP 和原生 AFE，这是让 MultiNet 生效的先决条件
# CONFIG_USE_AFE_WAKE_WORD is not set
# CONFIG_USE_WAKENET is not set
# CONFIG_SR_WN_WN9_HIESP is not set
# CONFIG_SR_WN_WN9_NIHAOXIAOZHI_TTS is not set

# 增加AFE环形缓冲区大小，给处理任务更多缓冲时间[reference:1]
CONFIG_AFE_RINGBUFFER_SIZE=8192

# 降低日志输出等级，避免串口打印抢占CPU资源[reference:2]
CONFIG_LOG_DEFAULT_LEVEL_WARN=y
CONFIG_LOG_DEFAULT_LEVEL=2
CONFIG_LOG_MAXIMUM_LEVEL=2

# 确保Wi-Fi缓冲区足够，避免网络波动间接影响音频任务
CONFIG_ESP_WIFI_STATIC_RX_BUFFER_NUM=16
CONFIG_ESP_WIFI_DYNAMIC_RX_BUFFER_NUM=32
```
